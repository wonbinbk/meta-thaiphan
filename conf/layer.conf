## conf/layer.conf
```bitbake
# We have a conf and classes directory, add to BBPATH
BBPATH .= ":${LAYERDIR}"

# We have recipes-* directories, add to BBFILES
BBFILES += "${LAYERDIR}/recipes-*/*/*.bb \
            ${LAYERDIR}/recipes-*/*/*.bbappend"

BBFILE_COLLECTIONS += "meta-thai.phan"
BBFILE_PATTERN_meta-thai.phan = "^${LAYERDIR}/"
BBFILE_PRIORITY_meta-thai.phan = "6"

LAYERDEPENDS_meta-thai.phan = "core"
LAYERSERIES_COMPAT_meta-thai.phan = "kirkstone"
```
